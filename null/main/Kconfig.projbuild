## null/main/Kconfig.projbuild
```kconfig
menu "I2C configuration GPIO"
	orsource "$IDF_PATH/examples/common_components/env_caps/$IDF_TARGET/Kconfig.env_caps"
     config I2C_MASTER_SCL
        int "SCL GPIO Num"
        range ENV_GPIO_RANGE_MIN ENV_GPIO_OUT_RANGE_MAX
        default 2
        help
            GPIO number for I2C Master clock line.

    config I2C_MASTER_SDA
        int "SDA GPIO Num"
        range ENV_GPIO_RANGE_MIN ENV_GPIO_OUT_RANGE_MAX
        default 1
        help
            GPIO number for I2C Master data line.

    config I2C_MASTER_FREQUENCY
        int "Master Frequency"
        default 400000
        help
            I2C Speed of Master device.

endmenu
```

## null_code/main/Kconfig.projbuild
```kconfig
menu "I2C configuration "
	orsource "$IDF_PATH/examples/common_components/env_caps/$IDF_TARGET/Kconfig.env_caps"
     config I2C_MASTER_SCL
        int "SCL GPIO Num"
        range ENV_GPIO_RANGE_MIN ENV_GPIO_OUT_RANGE_MAX
        default 2
        help
            GPIO number for I2C Master clock line.

    config I2C_MASTER_SDA
        int "SDA GPIO Num"
        range ENV_GPIO_RANGE_MIN ENV_GPIO_OUT_RANGE_MAX
        default 1
        help
            GPIO number for I2C Master data line.

    config I2C_MASTER_FREQUENCY
        int "Master Frequency"
        default 400000
        help
            I2C Speed of Master device.
    config I2C_DEVICE_ADDRESS 
	hex "Address"
	default 0x3c 
	help 
	    The address of the I2c device when initializing
    config HEIGHT_OLED 
	int "height"
	default 64
	help
	    the height of the oled display in pixels
    config WIDTH_OLED 
	int "width"
	default 128 
	help 
	    the width of the oled display in pixels
endmenu
menu "button IO configuration"
    orsource "$IDF_PATH/examples/common_components/env_caps/$IDF_TARGET/Kconfig.env_caps"
    config UP_BUTTON_GPIO
	int "GPIO_PIN"
	range ENV_GPIO_RANGE_MIN ENV_GPIO_OUT_RANGE_MAX
	default 3
	help
	    "the up button gpio"
    config DOWN_BUTTON_GPIO
	int "GPIO_PIN"
	range ENV_GPIO_RANGE_MIN ENV_GPIO_OUT_RANGE_MAX
	default 17
	help
	    "the down button gpio"
    config SELECT_BUTTON_GPIO
	int "GPIO_PIN"
	range ENV_GPIO_RANGE_MIN ENV_GPIO_OUT_RANGE_MAX
	default 18
	help
	    "the select button gpio"
endmenu
```
